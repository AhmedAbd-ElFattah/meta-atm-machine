## conf/layer.conf
```bitbake
# We have a conf and classes directory, add to BBPATH
BBPATH .= ":${LAYERDIR}"

# We have recipes-* directories, add to BBFILES
BBFILES += "${LAYERDIR}/recipes-*/*/*.bb \
            ${LAYERDIR}/recipes-*/*/*.bbappend"

BBFILE_COLLECTIONS += "meta-atm-machine"
BBFILE_PATTERN_meta-atm-machine = "^${LAYERDIR}/"
BBFILE_PRIORITY_meta-atm-machine = "6"

LAYERDEPENDS_meta-atm-machine = "core"
LAYERSERIES_COMPAT_meta-atm-machine = "dunfell"
```
